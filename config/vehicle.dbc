VERSION ""

NS_ :

BS_:

BU_: ECU IVI

BO_ 256 VehicleStatus: 8 ECU
 SG_ VehicleSpeed : 0|16@1+ (0.01,0) [0|655.35] "km/h" IVI
 SG_ DriveModeState : 16|8@1+ (1,0) [0|255] "" IVI

BO_ 257 EngineStatus: 8 ECU
 SG_ EngineRPM : 0|16@1+ (1,0) [0|65535] "rpm" IVI
 SG_ CoolantTemp : 16|16@1- (0.1,0) [-3276.8|3276.7] "degC" IVI

BO_ 258 TransmissionStatus: 8 ECU
 SG_ GearPosition : 0|8@1+ (1,0) [0|255] "" IVI

BO_ 260 BodyStatus: 8 ECU
 SG_ FuelLevel : 0|8@1+ (1,0) [0|255] "%" IVI

BO_ 288 SteeringStatus: 8 ECU
 SG_ SteeringWheelAngle : 0|16@1- (0.1,0) [-3276.8|3276.7] "deg" IVI
 SG_ SteeringCounter : 16|4@1+ (1,0) [0|15] "" IVI

BO_ 272 DriveModeCmd: 8 IVI
 SG_ DriveModeReq : 0|8@1+ (1,0) [0|255] "" ECU

CM_ BO_ 256 "Cyclic vehicle speed status from powertrain ECU";
CM_ BO_ 257 "Engine RPM and coolant temperature";
CM_ BO_ 258 "Selected gear position";
CM_ BO_ 260 "Body controller fuel level";
CM_ BO_ 288 "Steering-only status for dead-reckoning; cyclic @50Hz (20ms)";
CM_ BO_ 272 "Drive-mode command from IVI (cluster TX path)";
CM_ SG_ 256 VehicleSpeed "Road speed, 0.01 km/h per bit";
CM_ SG_ 256 DriveModeState "Active drive mode (read-back of DriveModeReq)";
CM_ SG_ 257 CoolantTemp "Engine coolant temperature, 0.1 degC per bit, signed";
CM_ SG_ 260 FuelLevel "Tank fuel level; operating range 0..100 %";
CM_ SG_ 288 SteeringWheelAngle "Absolute steering-wheel angle, 0.1 deg/bit, signed; operating range -720..+720 deg (+ = left/CCW)";
CM_ SG_ 288 SteeringCounter "Rolling alive counter 0..15, +1 per frame, wraps; receiver detects loss via (rx != (prev+1) mod 16)";
CM_ SG_ 272 DriveModeReq "Requested drive mode";

VAL_ 256 DriveModeState 0 "normal" 1 "eco" 2 "sport" 3 "snow" ;
VAL_ 258 GearPosition 0 "P" 1 "R" 2 "N" 3 "D" 4 "S" 5 "L" ;
VAL_ 272 DriveModeReq 0 "normal" 1 "eco" 2 "sport" 3 "snow" ;
